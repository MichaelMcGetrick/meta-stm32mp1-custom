## conf/layer.conf
```bitbake
# We have a conf and classes directory, add to BBPATH
BBPATH .= ":${LAYERDIR}"

# We have recipes-* directories, add to BBFILES
BBFILES += "${LAYERDIR}/recipes-*/*/*.bb \
            ${LAYERDIR}/recipes-*/*/*.bbappend"

BBFILE_COLLECTIONS += "meta-stm32mp1-custom"
BBFILE_PATTERN_meta-stm32mp1-custom = "^${LAYERDIR}/"
BBFILE_PRIORITY_meta-stm32mp1-custom = "6"

LAYERDEPENDS_meta-stm32mp1-custom = "core"
LAYERSERIES_COMPAT_meta-stm32mp1-custom = "mickledore"
```
